## config/west.yml
```yaml
manifest:
  remotes:
    - name: zmkfirmware
      url-base: https://github.com/zmkfirmware
    - name: sayu-hub  # pmw3610-driver のフォーク
      url-base: https://github.com/sayu-hub
    - name: Dist16384   # あなたのフォーク
      url-base: https://github.com/Dist16384
    - name: caksoylar  # <-- RGB LED
      url-base: https://github.com/caksoylar  

  projects:
    - name: zmk
      remote: zmkfirmware
      revision: v0.3
      path: zmk
      import: app/west.yml
    - name: zmk-pmw3610-driver
      remote: Dist16384
      revision: main
      path: modules/zmk-pmw3610-driver
    - name: zmk-rgbled-widget
      remote: caksoylar
      revision: main
      revision: v0.3

  self:
    path: config
```
